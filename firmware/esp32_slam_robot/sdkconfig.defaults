## firmware/esp32_slam_robot/sdkconfig.defaults
```kconfig
# ESP-IDF + micro-ROS 默认配置

# 启用 micro-ROS 所需的内存
CONFIG_ESP32_DEFAULT_CPU_FREQ_240=y
CONFIG_ESP32_DEFAULT_CPU_FREQ_MHZ=240

# micro-ROS 传输
CONFIG_MICRO_ROS_UDP_TRANSPORT=y

# 启用 WiFi
CONFIG_ESP32_WIFI_ENABLED=y
CONFIG_ESP32_WIFI_TASK_PINNED_TO_CORE_1=y

# 日志级别
CONFIG_LOG_DEFAULT_LEVEL_INFO=y

# 编译优化（针对 PID 计算）
CONFIG_COMPILER_OPTIMIZATION_PERF=y
```
